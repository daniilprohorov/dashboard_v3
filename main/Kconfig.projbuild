## main/Kconfig.projbuild
```kconfig
menu "Dashboard"

config DASH_DEMO
    bool "Demo mode"
    default n
    help
        Sweep all dashboard fields from minimum to a plausible maximum and back
        instead of showing real data. Off = poll OBD-II over CAN.

config DASH_CAN_BITRATE
    int "CAN bitrate, bit/s"
    default 500000
    help
        OBD-II on CAN uses 500000 or 250000 (ISO 15765-4).

config DASH_FUEL_TANK_L
    int "Fuel tank capacity, l"
    range 1 500
    default 50
    help
        Converts OBD fuel level (%) to litres for the F lvl cell.

config DASH_RPM_LIMIT
    int "Rev limiter, rpm"
    range 1000 20000
    default 6000
    help
        Engine rev limit. The RPM bar scale is this value rounded up to 1000;
        from (limit - 500) rpm the bar fill blinks red.

endmenu
```
